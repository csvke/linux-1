## drivers/bluetooth/mt7668u/Kconfig
```kconfig
config BT_MT7668U
	tristate "MediaTek MT7668U (USB) support"
	depends on USB
	---help---
	  This adds support for MT7668U-based USB bluetooth module.
```

## drivers/hisilicon/Kconfig
```kconfig
config HISILICON_VENDOR
	bool "HiSilicon vendor drivers support"
	help
	  It includes HiSilicon vendor drivers to support multimedia
	  functions like graphic, audio, video etc.

config HISI_WIFI_POWER
        tristate "Hisilicon WiFi power control"
        default n
```

## drivers/net/wireless/mediatek/mt7668/Kconfig
```kconfig
config MT7668
	tristate "MediaTek MT7668 support"
	depends on MAC80211
	select CFG80211_WEXT
	select WEXT_CORE
	select HISI_WIFI_POWER
	---help---
	  This adds support for MT7668-based wireless module.

config MTK_COMBO_WIFI_HIF
	depends on MT7668
	string "MediaTek combo WiFi HIF"
	default "usb"
```
